## config/dts/bindings/zmk,input-processor-accel.yaml
```yaml
description: "ZMK pointer acceleration input processor"

compatible: "zmk,input-processor-accel"

include: base.yaml

properties:
    input-type:
        type: int
        required: true
        description: "Event type to filter on. Typically 2 (INPUT_EV_REL)"
        
    track-remainders:
        type: boolean
        description: "Track fractional remainder across events"
        
    min-factor:
        type: int
        required: true
        description: "Scale factor * 1000 applied below speed-threshold"
        
    max-factor:
        type: int
        required: true
        description: "Scale factor * 1000 applied above speed-max"
        
    speed-threshold:
        type: int
        required: true
        description: "Speed (units/s) where acceleration begins"
        
    speed-max:
        type: int
        required: true
        description: "Speed (units/s) where max-factor is reached"
        
    acceleration-exponent:
        type: int
        required: true
        description: "Exponent for the acceleration curve"
```

## config/west.yml
```yaml
manifest:
  remotes:
    - name: zmkfirmware
      url-base: https://github.com/zmkfirmware
    - name: kumamuk-git
      url-base: https://github.com/kumamuk-git
    - name: eintim
      url-base: https://github.com/eintim
    - name: ShiniNet
      url-base: https://github.com/ShiniNet
    - name: kot149
      url-base: https://github.com/kot149
    - name: ssbb
      url-base: https://github.com/ssbb
    - name: sekigon-gonnoc
      url-base: https://github.com/sekigon-gonnoc
    - name: cormoran
      url-base: https://github.com/cormoran
  projects:
    - name: zmk
      remote: cormoran
      revision: v0.3-branch+dya
      import: app/west.yml
    - name: zmk-module-ble-management
      remote: cormoran
      revision: zmk-v0.3.0.0
    - name: zmk-module-battery-history
      remote: cormoran
      revision: main
    - name: zmk-driver-iqs9151
      remote: ShiniNet
      revision: main
    - name: zmk-behavior-battery-typer
      remote: eintim
      revision: main
    - name: zmk-mouse-gesture
      remote: kot149
      revision: v1
    - name: zmk-listeners
      remote: ssbb
      revision: v1
    - name: zmk-scroll-snap
      remote: kot149
      revision: v1
    - name: zmk-driver-paw3222
      remote: sekigon-gonnoc
      revision: main
    - name: zmk-module-runtime-input-processor
      remote: cormoran
      revision: zmk-v0.3.0.0
    - name: zmk-module-settings-rpc
      remote: cormoran
      revision: zmk-v0.3.0.0
    - name: zmk-feature-custom-settings
      remote: cormoran
      revision: 5727f85b3812b9456832784385d951a56f95a569
  self:
    path: config
```
